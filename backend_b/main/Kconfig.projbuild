## backend_b/main/Kconfig.projbuild
```kconfig
menu "Wireless DAP Backend"

config WDAP_WIFI_SSID
    string "SoftAP SSID"
    default "wireless-dap"

config WDAP_WIFI_PASSWORD
    string "SoftAP password"
    default "wirelessdap"

config WDAP_WIFI_CHANNEL
    int "SoftAP Wi-Fi channel"
    range 1 13
    default 6

config WDAP_UDP_PORT
    int "UDP listen port"
    range 1024 65535
    default 3333

config WDAP_BACKEND_MOCK_SWD
    bool "Enable mock SWD backend"
    default y

config WDAP_SWD_DEFAULT_HZ
    int "Default SWD clock"
    range 1000 10000000
    default 1000000

config WDAP_SWD_DIAG_VERBOSE
    bool "Enable verbose SWD diagnostics"
    default n

config WDAP_SWD_SWCLK_GPIO
    int "SWCLK GPIO"
    range 0 48
    default 5

config WDAP_SWD_SWDIO_GPIO
    int "SWDIO GPIO"
    range 0 48
    default 4

config WDAP_TARGET_NRST_GPIO
    int "Target nRESET GPIO"
    range 0 48
    default 6

config WDAP_UART_BRIDGE_PORT_NUM
    int "UART bridge port number"
    range 1 2
    default 1

config WDAP_UART_BRIDGE_TX_GPIO
    int "UART bridge TX GPIO"
    range 0 48
    default 17

config WDAP_UART_BRIDGE_RX_GPIO
    int "UART bridge RX GPIO"
    range 0 48
    default 18

config WDAP_UART_BRIDGE_BAUDRATE
    int "UART bridge default baud rate"
    range 1200 5000000
    default 115200

config WDAP_TARGET_RESET_PULSE_MS
    int "Target reset pulse in milliseconds"
    range 1 1000
    default 20

config WDAP_TARGET_RESET_SETTLE_MS
    int "Target reset settle time in milliseconds"
    range 0 1000
    default 5

endmenu
```

## frontend_a/main/Kconfig.projbuild
```kconfig
menu "Wireless DAP Frontend"

config WDAP_WIFI_SSID
    string "Backend SoftAP SSID"
    default "wireless-dap"

config WDAP_WIFI_PASSWORD
    string "Backend SoftAP password"
    default "wirelessdap"

config WDAP_BACKEND_IP
    string "Backend IP address"
    default "192.168.4.1"

config WDAP_UDP_PORT
    int "Backend UDP port"
    range 1024 65535
    default 3333

config WDAP_REQUEST_TIMEOUT_MS
    int "Request timeout in milliseconds"
    range 100 10000
    default 3000

config WDAP_FRONTEND_RETRY_COUNT
    int "Retries per request"
    range 0 5
    default 1

config WDAP_HEARTBEAT_INTERVAL_MS
    int "Heartbeat idle interval in milliseconds"
    range 1000 60000
    default 5000

endmenu
```
