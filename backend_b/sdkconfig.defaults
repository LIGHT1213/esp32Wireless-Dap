## backend_b/sdkconfig.defaults
```kconfig
CONFIG_IDF_TARGET="esp32s3"
# CONFIG_WDAP_ROLE_FRONTEND is not set
CONFIG_WDAP_ROLE_BACKEND=y
CONFIG_WDAP_ESPNOW_CHANNEL=6
CONFIG_WDAP_ESPNOW_PAYLOAD_MTU=1460
CONFIG_WDAP_DAP_PACKET_SIZE=512
CONFIG_WDAP_DAP_PACKET_COUNT=8
CONFIG_WDAP_TRANSFER_TIMEOUT_MS=3000
CONFIG_WDAP_ESPNOW_RETRY_COUNT=8
CONFIG_ESP_MAIN_TASK_STACK_SIZE=8192
CONFIG_FREERTOS_HZ=1000

CONFIG_COMPILER_OPTIMIZATION_PERF=y

CONFIG_COMPILER_OPTIMIZATION_ASSERTIONS_DISABLE=y

CONFIG_ESP_DEFAULT_CPU_FREQ_MHZ_240=y
```

## components/board_config/Kconfig
```kconfig
menu "Wireless DAP configuration"

config WDAP_ROLE_FRONTEND
    bool "Build frontend A role"
    default n

config WDAP_ROLE_BACKEND
    bool "Build backend B role"
    default n

config WDAP_ESPNOW_CHANNEL
    int "ESP-NOW Wi-Fi channel"
    range 1 13
    default 6

config WDAP_ESPNOW_PAYLOAD_MTU
    int "ESP-NOW reliable payload MTU"
    range 32 1460
    default 1460

config WDAP_DAP_PACKET_SIZE
    int "CMSIS-DAP packet size"
    range 64 512
    default 64

config WDAP_DAP_PACKET_COUNT
    int "CMSIS-DAP packet count"
    range 1 16
    default 8

config WDAP_USB_HID_FALLBACK
    bool "Enable trailing HID compatibility interface"
    default y
    help
        The HID interface is placed after the CMSIS-DAP v2 WinUSB bulk interface
        so Keil should prefer v2. It is not intended as the primary high-speed path.

config WDAP_TRANSFER_TIMEOUT_MS
    int "DAP request timeout in milliseconds"
    range 100 30000
    default 3000

config WDAP_ESPNOW_RETRY_COUNT
    int "ESP-NOW fragment retry count"
    range 1 32
    default 8

endmenu
```

## frontend_a/sdkconfig.defaults
```kconfig
CONFIG_IDF_TARGET="esp32s3"
CONFIG_WDAP_ROLE_FRONTEND=y
# CONFIG_WDAP_ROLE_BACKEND is not set
CONFIG_WDAP_ESPNOW_CHANNEL=6
CONFIG_WDAP_ESPNOW_PAYLOAD_MTU=1460
CONFIG_WDAP_DAP_PACKET_SIZE=512
CONFIG_WDAP_DAP_PACKET_COUNT=8
CONFIG_WDAP_TRANSFER_TIMEOUT_MS=3000
CONFIG_WDAP_ESPNOW_RETRY_COUNT=8
CONFIG_TINYUSB_HID_COUNT=1
CONFIG_TINYUSB_VENDOR_COUNT=1
CONFIG_TINYUSB_VENDOR_RX_BUFSIZE=1024
CONFIG_TINYUSB_VENDOR_TX_BUFSIZE=1024
CONFIG_TINYUSB_VENDOR_EPSIZE=64
CONFIG_ESP_MAIN_TASK_STACK_SIZE=8192
CONFIG_FREERTOS_HZ=1000
CONFIG_WDAP_USB_HID_FALLBACK=y

CONFIG_COMPILER_OPTIMIZATION_PERF=y

CONFIG_COMPILER_OPTIMIZATION_ASSERTIONS_DISABLE=y

CONFIG_ESP_DEFAULT_CPU_FREQ_MHZ_240=y
```
